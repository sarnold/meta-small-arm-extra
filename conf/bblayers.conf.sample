## conf/machine/pine64-plus.conf
```bitbake
#@TYPE: Machine
#@NAME: pine64-plus

#@DESCRIPTION: Machine configuration for pine64/pine64-plus systems

require conf/machine/include/arm/arch-arm64.inc

SOC_FAMILY = "a64"
# including soc-family.inc requires poky metadata
require conf/machine/include/soc-family.inc

PREFERRED_PROVIDER_virtual/bootloader ?= "u-boot"
PREFERRED_VERSION_u-boot ?= "2020%"
PREFERRED_PROVIDER_virtual/kernel ?= "linux-mainline"
PREFERRED_VERSION_linux-mainline ?= "5.10%"

EXTRA_IMAGEDEPENDS += "virtual/trusted-firmware-a u-boot"

UBOOT_BINARY ?= "u-boot-sunxi-with-spl.bin"
SPL_BINARY ?= "spl/sunxi-spl.bin"
UBOOT_ENTRYPOINT = "0x40080000"
UBOOT_DTB_LOADADDRESS = "0x4FA00000"

UBOOT_EXTLINUX = "1"
UBOOT_EXTLINUX_ROOT = "root=/dev/mmcblk0p1"
UBOOT_EXTLINUX_FDT = "../sun50i-a64-pine64-plus.dtb"
UBOOT_EXTLINUX_CONSOLE = "console=ttyS0,115200n8"

TFA_PLATFORM = "sun50i_a64"
TFA_BUILD_TARGET = "bl31"

KERNEL_DEVICETREE = "allwinner/sun50i-a64-pine64-plus.dtb allwinner/sun50i-a64-pine64.dtb"

UBOOT_MACHINE ?= "pine64_plus_defconfig"

ROOT_HOME ?= "/root"

KERNEL_IMAGETYPE = "Image"
IMAGE_BOOT_FILES ?= " \
    ${KERNEL_DEVICETREE} \
    ${KERNEL_IMAGETYPE} \
"

IMAGE_FSTYPES_append = " tar.bz2 wic"
WKS_FILE ?= "sdcard-pine64.wks"

WKS_FILE_DEPENDS ?= " \
    e2fsprogs-native \
    bmap-tools-native \
"

MACHINE_ESSENTIAL_EXTRA_RDEPENDS += "\
    kernel-devicetree \
    kernel-image \
    kernel-modules \
    u-boot-conf \
"

SERIAL_CONSOLE ?= "115200 ttyS0"
MACHINE_FEATURES ?= "alsa apm keyboard rtc serial screen usbgadget usbhost vfat ext2 ext3"

BAD_RECOMMENDATIONS = " libavahi-core avahi-utils avahi-daemon avahi-autoipd libnss-mdns fbset consolekit wireless-tools "
RDEPENDS_pulseaudio-module-console-kit_remove = "consolekit"
DISTRO_FEATURES_remove ?= "zeroconf"

VIRTUAL-RUNTIME_wireless-tools = "iw"
```

## conf/machine/roc-rk3328-cc.conf
```bitbake
#@TYPE: Machine
#@NAME: ROC-RK3328-CC
#@DESCRIPTION: ROC rk3328 CC Renegade is a Rockchip RK3328-based SBC by Libre Computer
#https://roc-rk3328-cc.readthedocs.io/en/latest/index.html

require conf/machine/include/rk3328.inc

MACHINEOVERRIDES =. "roc-rk3328-cc:"

PREFERRED_PROVIDER_virtual/bootloader ?= "u-boot"
PREFERRED_PROVIDER_virtual/kernel ?= "linux-yocto"
#PREFERRED_VERSION_linux-yocto ?= "6.%"

KERNEL_DEVICETREE = "rockchip/rk3328-roc-cc.dtb"
MACHINE_FEATURES += "alsa keyboard rtc serial screen usbgadget usbhost vfat ext2"
MACHINE_ESSENTIAL_EXTRA_RRECOMMENDS += "kernel-modules"

UBOOT_MACHINE = "roc-cc-rk3328_defconfig"

WKS_FILE ?= "sdcard-rockchip.wks"
```

## wic/sdcard-esp.wks
```
# short-description: Create espressobin SD card image
# long-description: Creates single-partition SD card image. Boot files
# are located in /boot on the main partition.
#

part / --source rootfs --ondisk mmcblk --fstype=ext4 --mkfs-extraopts "-O ^metadata_csum,^64bit" --label rootfs --align 4096
```

## wic/sdcard-pine64.wks
```
# short-description: Create Pine64 SD card image
# long-description: Creates a partitioned SD card image. Boot files
# are located in /boot on the first partition and raw bootloaders are
# placed in the raw SD.
#
# The disk layout used is:
#
#    0           -> reserverd
#    8 KiB       -> u-boot SPL and u-boot
#    20480 KiB   -> rootfs
#

bootloader --ptable msdos

part spl --offset 8 --ondisk mmcblk0 --no-table --source rawcopy --sourceparams="file=u-boot-sunxi-with-spl.bin"
part / --offset 20480 --source rootfs --ondisk mmcblk --fstype=ext4 --mkfs-extraopts "-O ^metadata_csum,^64bit" --label rootfs --align 4096
```

## wic/sdcard-rockchip.wks
```
# for mainline uboot
# sudo dd if=idbloader.img of=/dev/mmcblk1 seek=64
# sudo dd if=u-boot.itb of=/dev/mmcblk1 seek=16384

part /SPL --source rawcopy --sourceparams="file=${SPL_BINARY}" --ondisk mmcblk --no-table --align 32
part /SPL --source rawcopy --sourceparams="file=u-boot.${UBOOT_SUFFIX}" --ondisk mmcblk --no-table --align 8192
part / --offset 16M --source rootfs --ondisk mmcblk --fstype=ext4 --mkfs-extraopts "-O ^metadata_csum,^64bit" --label rootfs --align 4096
```
