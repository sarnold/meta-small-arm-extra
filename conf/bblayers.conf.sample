## conf/bblayers.conf.sample
```bitbake
# LAYER_CONF_VERSION is increased each time build/conf/bblayers.conf
# changes incompatibly
LCONF_VERSION = "7"

BBPATH = "${TOPDIR}"
BBFILES ?= ""

OEROOT = "/home/sarnold/beagleboard-oecore/oe-core"

BBLAYERS ?= " \
  ${OEROOT}/meta \
  ${OEROOT}/meta-small-arm-extra \
  ${OEROOT}/meta-ti \
  ${OEROOT}/meta-qt5 \
  ${OEROOT}/meta-browser \
  ${OEROOT}/meta-openembedded/meta-oe \
  ${OEROOT}/meta-openembedded/meta-networking \
  ${OEROOT}/meta-openembedded/meta-python \
  ${OEROOT}/meta-openembedded/meta-multimedia \
  ${OEROOT}/meta-openembedded/meta-filesystems \
  ${OEROOT}/meta-openembedded/meta-efl \
  ${OEROOT}/meta-openembedded/meta-gnome \
  "

#  ${OEROOT}/meta-beagleboard/common-bsp
```

## conf/distro/include/default-vctlabs-vars.inc
```bitbake
DISTRO_FEATURES_append = " opengl"
DISTRO_FEATURES_BACKFILL_CONSIDERED ?= "systemd"

#LOCALE_UTF8_ONLY = "1"
#LOCALE_UTF8_IS_DEFAULT = "1"
IMAGE_LINGUAS = "en-us en-gb de-de fr-fr es-mx pt-br it-it"
#LIMIT_BUILT_LOCALES = "POSIX en_US en_GB de_DE fr_FR es_MX pt_BR it_IT"

# for building morty on hardened
GCCVERSION = "6.2%"
SDKGCCVERSION = "${GCCVERSION}"
BINUVERSION = "2.27%"
GDBVERSION = "7.11%"
GLIBCVERSION = "2.24"

COMMERCIAL_AUDIO_PLUGINS = "gst-plugins-ugly-mad gst-plugins-ugly-mpegaudioparse"
COMMERCIAL_VIDEO_PLUGINS = "gst-plugins-ugly-mpeg2dec gst-plugins-ugly-mpegstream gst-plugins-bad-mpegvideoparse"
```

## conf/distro/orchard.conf
```bitbake
DISTRO = "vctlabs"
DISTRO_NAME = "Orchard (Orchard Systems Mainline Reference Distro)"
DISTRO_VERSION = "1.0"
DISTRO_CODENAME = "morty"
SDK_VENDOR = "-orchardsdk"
SDK_VERSION := "${@'${DISTRO_VERSION}'.replace('snapshot-${DATE}','snapshot')}"

#MAINTAINER = "Steve Arnold <nerdboy@gentoo.org>"

TARGET_VENDOR = "-orchard"

DISTRO_VERSION[vardepsexclude] = "DATE"
#SDK_VERSION[vardepsexclude] = "DATE"

PREFERRED_PROVIDER_virtual/kernel ?= "linux-armv7multi"
#PREFERRED_VERSION_linux-bb-kernel ?= "4.18%"
PREFERRED_PROVIDER_virtual/bootloader ?= "u-boot"
#PREFERRED_VERSION_virtual/bootloader ?= "2018.11%"

VIRTUAL-RUNTIME_dev_manager ??= "udev"
VIRTUAL-RUNTIME_login_manager ??= "busybox"
VIRTUAL-RUNTIME_init_manager ??= "sysvinit"
VIRTUAL-RUNTIME_initscripts ??= "initscripts"
VIRTUAL-RUNTIME_keymaps ??= "keymaps"

PREFERRED_PROVIDER_virtual/egl ?= "mesa"
PREFERRED_PROVIDER_virtual/libgl ?= "mesa"
PREFERRED_PROVIDER_virtual/libgles1 ?= "mesa"
PREFERRED_PROVIDER_virtual/libgles2 ?= "mesa"
PREFERRED_PROVIDER_virtual/libg2d ?= "mesa"

PREFERRED_PROVIDER_jpeg ?= "libjpeg-turbo"
PREFERRED_PROVIDER_jpeg-native ?= "libjpeg-turbo-native"

# most of these are set in rpi/machine/include/rpi-default-providers.inc
PREFERRED_PROVIDER_xserver_common ?= "x11-common"

DISTRO_FEATURES_append = " opengl"
DISTRO_FEATURES_BACKFILL_CONSIDERED ?= "multiarch pulseaudio systemd"

#LOCALE_UTF8_ONLY = "1"
#LOCALE_UTF8_IS_DEFAULT = "1"
IMAGE_LINGUAS = "en-us en-gb de-de fr-fr es-mx pt-br it-it"
#LIMIT_BUILT_LOCALES = "POSIX en_US en_GB de_DE fr_FR es_MX pt_BR it_IT"

COMMERCIAL_AUDIO_PLUGINS = "gst-plugins-ugly-mad gst-plugins-ugly-mpegaudioparse"
COMMERCIAL_VIDEO_PLUGINS = "gst-plugins-ugly-mpeg2dec gst-plugins-ugly-mpegstream gst-plugins-bad-mpegvideoparse"
```

## conf/distro/vctlabs.conf
```bitbake
DISTRO = "vctlabs"
DISTRO_NAME = "VCTLabs (VCT Labs Bleeding Edge Reference Distro)"
DISTRO_VERSION = "1.0"
#SDK_VENDOR = "-vctsdk"
#SDK_VERSION := "${@'${DISTRO_VERSION}'.replace('snapshot-${DATE}','snapshot')}"

#MAINTAINER = "Answers <answers@vctlabs.com>"

#TARGET_VENDOR = "-vctlabs"

DISTRO_VERSION[vardepsexclude] = "DATE"
#SDK_VERSION[vardepsexclude] = "DATE"

PREFERRED_PROVIDER_virtual/kernel ?= "linux-mainline"
#PREFERRED_VERSION_linux-mainline ?= "5.10%"
PREFERRED_PROVIDER_virtual/bootloader ?= "u-boot"
#PREFERRED_VERSION_virtual/bootloader ?= "v2020.10"

PREFERRED_PROVIDER_virtual/egl ?= "mesa"
PREFERRED_PROVIDER_virtual/libgl ?= "mesa"
PREFERRED_PROVIDER_virtual/libgles1 ?= "mesa"
PREFERRED_PROVIDER_virtual/libgles2 ?= "mesa"
PREFERRED_PROVIDER_virtual/libg2d ?= "mesa"

PREFERRED_PROVIDER_jpeg ?= "libjpeg-turbo"
PREFERRED_PROVIDER_jpeg-native ?= "libjpeg-turbo-native"

DISTRO_FEATURES_BACKFILL_CONSIDERED ?= "multiarch pulseaudio"

# We want images supporting the following features (for packagegroup(-core)-base)

DISTRO_FEATURES = " \
    alsa \
    argp \
    bluetooth \
    ext2 \
    ipv4 \
    ipv6 \
    irda \
    largefile \
    nfs \
    pam \
    pci \
    pcmcia \
    ppp \
    smbfs \
    sysvinit \
    usbgadget \
    usbhost \
    vfat \
    wifi \
    xattr \
    zeroconf \
    gobject-introspection-data \
"

# Disable systemd for recipes with sysvinit support
DISTRO_FEATURES_BACKFILL_CONSIDERED += "multiarch systemd"
VIRTUAL-RUNTIME_init_manager ?= "sysvinit"
VIRTUAL-RUNTIME_dev_manager ?= "udev"

# USE-flag like features
DISTRO_FEATURES += "tk"
DISTRO_FEATURES += "x11"
DISTRO_FEATURES += "pulseaudio"
DISTRO_FEATURES += "ldconfig"
DISTRO_FEATURES += "polkit"
DISTRO_FEATURES += "helpfiles"

# OpenGL support
DISTRO_FEATURES += "opengl"

# wayland...
DISTRO_WAYLAND = "wayland"
DISTRO_WAYLAND:use-mainline-bsp = "wayland"
DISTRO_FEATURES += "${DISTRO_WAYLAND}"

# vulkan
DISTRO_VULKAN = ""
DISTRO_VULKAN:raspberrypi4 = "vulkan"
DISTRO_VULKAN:raspberrypi4-64 = "vulkan"
DISTRO_FEATURES += "${DISTRO_VULKAN}"

#LOCALE_UTF8_ONLY = "1"
#LOCALE_UTF8_IS_DEFAULT = "1"
IMAGE_LINGUAS = "en-us en-gb de-de fr-fr es-mx pt-br it-it"
#LIMIT_BUILT_LOCALES = "POSIX en_US en_GB de_DE fr_FR es_MX pt_BR it_IT"

COMMERCIAL_AUDIO_PLUGINS = "gst-plugins-ugly-mad gst-plugins-ugly-mpegaudioparse"
COMMERCIAL_VIDEO_PLUGINS = "gst-plugins-ugly-mpeg2dec gst-plugins-ugly-mpegstream gst-plugins-bad-mpegvideoparse"
```

## conf/layer.conf
```bitbake
# We might have a conf and classes directory, append to BBPATH
BBPATH .= ":${LAYERDIR}"

# We have a recipes directory, add to BBFILES
BBFILES += "${LAYERDIR}/recipes*/*/*.bb \
            ${LAYERDIR}/recipes*/*/*.bbappend"

BBFILE_COLLECTIONS += "smallarmextra"
BBFILE_PATTERN_smallarmextra := "^${LAYERDIR}/"
BBFILE_PRIORITY_smallarmextra = "9"
LAYERVERSION_smallarmextra = "2"

LAYERDEPENDS_smallarmextra = "core openembedded-layer"
LAYERSERIES_COMPAT_smallarmextra = "dunfell gatesgarth hardknott honister"
```

## conf/local.conf.sample
```bitbake
# set distro for OE or leave blank for "OpenEmbedded nodistro.0"
DISTRO = "vctlabs"

# We default to ipk:
PACKAGE_CLASSES ?= "package_ipk"

# adjust machine features from meta-ti to include keyboard
MACHINE_FEATURES = "keyboard apm usbgadget usbhost vfat rtc ext2 screen alsa ethernet sgx"

# this should pull in xuser-account package and start X correctly
BBMASK ?= ".*/meta-oe/recipes-graphics/xserver-nodm-init/"
#PREFERRED_VERSION_xserver-nodm-init = "1.0"
ROOTLESS_X = "1"

CORE_IMAGE_EXTRA_INSTALL += "\
    kernel-modules \
    libcgroup \
    zram \
    nano \
    vim \
    vim-vimrc \
    vim-syntax \
    ntp \
    ltp \
    git \
    rsync \
    bash \
    screen \
    pax-utils \
    pps-tools \
    mtd-utils \
    devmem2 \
    sysfsutils \
    spitools \
    i2c-tools \
    usbutils \
    distro-feed-configs \
    cpufrequtils \
    gkrellmd \
    sqlite3 \
    python-sqlite3 \
    python-sqlite3-tests \
    python-modules \
    python-misc \
    python-pyyaml \
    python-git \
    python-apsw \
    neobunch \
    python-evdev \
    libevdev \
    python-redis \
    redis \
    lighttpd \
    lighttpd-module-cgi \
    lighttpd-module-alias \
    lighttpd-module-status \
    lighttpd-module-setenv \
    lighttpd-module-compress \
    lighttpd-module-redirect \
    python-reportlab \
    python-pillow \
    perl \
    perl-misc \
    perl-modules \
    ghostscript \
    poppler \
    qpdf \
    cups \
    pycups \
    cups-filters \
    cups-filters-gst \
    cups-filters-data \
    alsa-lib \
    alsa-tools \
    alsa-state \
    alsa-utils \
    alsa-utils-scripts \
    ${BB_BRINGUP} \
    ${TOUCH} \
    ${QT5} \
    ${BB_X11} \
    ${DEV_TOOLS} \
"

BB_BRINGUP = " \
    tzdata \
    iw \
    bonnie++ \
    hdparm \
    iozone3 \
    iperf \
    lmbench \
    rt-tests \
    evtest \
    bc \
    memtester \
"

BB_X11 = " \
    localedef \
    libx11-locale \
    xserver-xf86-config \
    xorg-minimal-fonts \
    xkeyboard-config \
    setxkbmap \
    xmodmap \
    xrdb \
"

BB_X11_EXTRA = " \
    packagegroup-base-apm \
    packagegroup-fonts-truetype-core \
    lxdm \
    libxi \
    libxtst \
    rgb \
    xprop \
    xterm \
"

BB_XFCE = " \
    packagegroup-xfce-extended \
    packagegroup-xfce-multimedia \
"

TOUCH = "\
    tslib-conf \
    tslib-tests \
    tslib-calibrate \
    tslib \
    evtest \
    dbus \
"

# note: qt5-opengles2-test fails to compile with mesa as GL provider
QT5 = "\
    qtbase \
    qtbase-tools \
    qtbase-plugins \
    qtbase-fonts \
    qtwebkit \
    qtwebkit-qmlplugins \
    qtwebkit-examples \
    qtwebkit-examples-examples \
    qt5-demo-extrafiles \
    cinematicexperience \
    qt5everywheredemo \
    qt5ledscreen \
    qt5nmapper \
    qt-webkit-kiosk \
    gstreamer \
    cairo \
    pango \
    fontconfig \
    freetype \
"

DEV_TOOLS = "\
    ti-cgt-pru \
    diffutils \
    python-docutils \
    python-pyserial \
    python-pyusb \
    python-pip \
    guile \
    bison \
    flex \
    yasm \
    gdb \
"

DEFAULT_TEST_SUITES_remove = "connman"

# epiphany needs gnome-keyring, versions out of sync (poky/meta-oe is old)

IMAGE_FEATURES += "splash ssh-server-openssh package-management x11 x11-base"
#IMAGE_FEATURES += "splash ssh-server-openssh package-management"

EXTRA_IMAGE_FEATURES = "debug-tweaks ptest-pkgs tools-sdk tools-debug tools-testapps"

MACHINE = "beaglebone"
#BBMASK ?= ".*/meta-ti/recipes-misc/(images|payload)/"

DEFAULTTUNE = "cortexa8hf-neon"
COMPATIBLE_MACHINE_beaglebone = "beaglebone"

# this is needed if not using yocto bsp beaglebone machine config
# see also extra u-boot settings in bbappend
IMAGE_BOOT_FILES = "u-boot.${UBOOT_SUFFIX} MLO"

SERIAL_CONSOLES_beaglebone = "115200;ttyS0"
IMAGE_FSTYPES = "tar.bz2"

#PREFERRED_PROVIDER_virtual/kernel = "linux-bb-kernel"
#PREFERRED_VERSION_linux-bb-kernel = "4.6%"
PREFERRED_PROVIDER_virtual/kernel = "linux-ti-dev"
PREFERRED_VERSION_linux-boneblack = "4.4%"

PREFERRED_PROVIDER_virtual/bootloader = "u-boot"
#PREFERRED_VERSION_virtual/bootloader = "2016.03%"

VIRTUAL-RUNTIME_dev_manager = "udev"
VIRTUAL-RUNTIME_login_manager = "busybox"
VIRTUAL-RUNTIME_init_manager = "sysvinit"
VIRTUAL-RUNTIME_initscripts = "initscripts"
VIRTUAL-RUNTIME_keymaps = "keymaps"

PREFERRED_PROVIDER_virtual/mesa = "mesa"
PREFERRED_PROVIDER_virtual/libgl = "mesa"
REFERRED_PROVIDER_virtual/egl = "mesa"
#PREFERRED_PROVIDER_virtual/libgles2 = "mesa"

PREFERRED_PROVIDER_jpeg = "libjpeg-turbo"
PREFERRED_PROVIDER_jpeg-native = "libjpeg-turbo-native"

PACKAGECONFIG_pn-cups = "acl pam"
PACKAGECONFIG_pn-poppler = "jpeg png tiff curl"
PACKAGECONFIG_pn-cups-filters = "jpeg png tiff dbus"

PACKAGECONFIG_pn-openbox = "xrandr xcursor startup-notification"
PACKAGECONFIG_pn-libxfce4ui = "gladeui startup-notification"
PACKAGECONFIG_pn-vim = "acl gtkgui x11"

DL_DIR = "/home/sarnold/shared/downloads"
SSTATE_DIR = "/home/sarnold/shared/oe/sstate-cache"
PERSISTENT_DIR = "/home/sarnold/shared/oe-core"

INHERIT += "rm_work"
INHERIT += "toaster"

# enable the PR service
PRSERV_HOST = "localhost:0"
INHERIT += "buildhistory"
BUILDHISTORY_COMMIT = "1"

# need this for real-time audio (includes RT_GROUP_SCHED)
KERNEL_ENABLE_CGROUPS = "1"

# try out java/fortran support
#   disable java if tools-sdk is in IMAGE FEATURES
#JAVA = ",java"
#JAVA_arm = ",java"
FORTRAN = ",fortran"
FORTRAN_forcevariable = ",fortran"
RUNTIMETARGET_append_pn-gcc-runtime = " libquadmath"

# set color of beaglebone (leave blank or set to 0 for white)
BONE_IS_BLACK = "1"

# possible values are internal or external
CUSTOM_FEED_CONFIG = "internal"

# set internal feed URL
CUSTOM_FEED_URL = "slarti"

LICENSE_FLAGS_WHITELIST = "\
  commercial_gst-fluendo-mp3 \
  commercial_gst-openmax \
  commercial_gst-plugins-ugly \
  commercial \
  commercial_lame \
  commercial_libmad \
  commercial_libomxil \
  commercial_mpeg2dec \
  commercial_qmmp"

#DISTRO_FEATURES_append = " pam sysvinit udev "
DISTRO_FEATURES_append = " opengl pam pulseaudio sysvinit udev x11"

#DISTRO_FEATURES_BACKFILL_CONSIDERED = "multiarch pulseaudio systemd"
# need to allow pulseaudio for epiphany  :/
DISTRO_FEATURES_BACKFILL_CONSIDERED = "multiarch systemd"


# Additional image features
USER_CLASSES ?= "buildstats image-mklibs"
#OE_TERMINAL = "auto"
PATCHRESOLVE = "noop"

BB_DISKMON_DIRS = "\
    STOPTASKS,${TMPDIR},1G,100K \
    STOPTASKS,${DL_DIR},1G,100K \
    STOPTASKS,${SSTATE_DIR},1G,100K \
    STOPTASKS,/tmp,100M,100K \
    ABORT,${TMPDIR},100M,1K \
    ABORT,${DL_DIR},100M,1K \
    ABORT,${SSTATE_DIR},100M,1K \
    ABORT,/tmp,10M,1K"

#SSTATE_MIRRORS ?= "\
#file://.* http://someserver.tld/share/sstate/PATH;downloadfilename=PATH \n \
#file://.* file:///some/local/dir/sstate/PATH"

#PACKAGECONFIG_append_pn-qemu-native = " sdl"
#PACKAGECONFIG_append_pn-nativesdk-qemu = " sdl"
ASSUME_PROVIDED += "qemu-native libsdl-native"

CONF_VERSION = "1"
```

## conf/machine/espressobin.conf
```bitbake
#@TYPE: Machine
#@NAME: espressobin (og)

#@DESCRIPTION: Machine configuration for the original v5 DDR3 boards

require conf/machine/include/arm/arch-arm64.inc

MACHINEOVERRIDES =. "espressobin:"

MACHINE_ENDIANNESS ?= "le"

PREFERRED_PROVIDER_virtual/bootloader ?= "u-boot"
PREFERRED_VERSION_u-boot ?= "2022%"
PREFERRED_PROVIDER_virtual/kernel ?= "linux-mainline"
PREFERRED_VERSION_linux-mainline ?= "5.16%"

KERNEL_DEVICETREE ?= "marvell/armada-3720-espressobin.dtb"
KERNEL_MODULE_AUTOLOAD += "marvell-cesa ansi_cprng"

PACKAGECONFIG_pn_mesa = "\
    ${@bb.utils.filter('DISTRO_FEATURES', 'wayland ', d)} \
    ${@bb.utils.contains('DISTRO_FEATURES', 'opengl', 'opengl egl gles gbm dri', '', d)} \
    ${@bb.utils.contains('DISTRO_FEATURES', 'x11 opengl', 'x11', '', d)} \
    ${@bb.utils.contains('DISTRO_FEATURES', 'x11 vulkan', 'dri3', '', d)} \
    gallium \
"

ROOT_HOME ?= "/root"

KERNEL_IMAGETYPE = "Image"
IMAGE_BOOT_FILES ?= " \
    ${KERNEL_DEVICETREE} \
    ${KERNEL_IMAGETYPE} \
"

IMAGE_FSTYPES ?= "tar.bz2 ext4 wic"
WKS_FILE ?= "sdcard-esp.wks"

WKS_FILE_DEPENDS = " \
    e2fsprogs-native \
    bmap-tools-native \
"

EXTRA_IMAGECMD_ext4 = "-O ^metadata_csum,^64bit"

SERIAL_CONSOLE = "115200 ttyMV0"

MACHINE_FEATURES = "ext2 ipsec nfs pci smbfs usbgadget usbhost vfat"

UBOOT_MACHINE ?= "mvebu_espressobin-88f3720_defconfig"

#UBOOT_EXTLINUX = "1"
#UBOOT_EXTLINUX_FDT = "../armada-3720-espressobin.dtb"
#UBOOT_EXTLINUX_CONSOLE = "console=ttyMV0,11520"
#UBOOT_EXTLINUX_ROOT = "root=/dev/mmcblk0p1"
#UBOOT_EXTLINUX_KERNEL_IMAGE = "../Image"
#UBOOT_EXTLINUX_KERNEL_ARGS_append = " rootwait rw net.ifnames=0 biosdevname=0"

MACHINE_ESSENTIAL_EXTRA_RDEPENDS += "\
    kernel-devicetree \
    kernel-image \
    kernel-modules \
"

MACHINE_FEATURES_BACKFILL_CONSIDERED = "\
    rtc \
    qemu-usermode \
"
```
